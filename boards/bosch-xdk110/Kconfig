## boards/bosch-xdk110/Kconfig
```kconfig
# Copyright (c) 2023 SimonIT
#
# This file is subject to the terms and conditions of the GNU Lesser
# General Public License v2.1. See the file LICENSE in the top level
# directory for more details.

config BOARD
    default "bosch-xdk110" if BOARD_BOSCH_XDK110

config BOARD_BOSCH_XDK110
    bool
    default y
    select CPU_MODEL_EFM32GG390F1024

    # Put defined MCU peripherals here (in alphabetical order)

    # Put other features for this board (in alphabetical order)
```
